## west.yml
```yaml
manifest:
  self:
    path: mainRoot
#    west-commands: scripts/west-commands.yml

  remotes:
    - name: zephyrproject-rtos
      url-base: https://github.com/zephyrproject-rtos

    - name: cmsis-svd
      url-base: https://github.com/cmsis-svd
      
    - name: cb
      url-base: git@github.com:BiologIC-Colin

  projects:
    - name: zephyr
      remote: zephyrproject-rtos
      revision: v4.4.2
      import:
         name-allowlist:
            - cmsis
            - cmsis_6
            - mcuboot
            - zcbor
            - mbedtls
            - picolibc
            - libc3
            - hal_stm32
            - hal_rpi_pico
            - cmsis-dsp
            - segger
      
    - name: cmsis-svd-data
      remote: cmsis-svd
      revision: main
      
    - name: apps_zephyr_home
      remote: cb
      revision: master
      path: apps

    - name: boards_zephyr_home
      remote: cb
      revision: master
      path: boards

    - name: drivers_zephyr_home
      remote: cb
      revision: master
      path: drivers
      
    - name: libs_zephyr_home
      remote: cb
      revision: master
      path: libs
```
